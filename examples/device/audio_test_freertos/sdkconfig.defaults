## examples/device/audio_test_freertos/sdkconfig.defaults
```kconfig
CONFIG_IDF_CMAKE=y
# 1000 Hz tick: the UAC iso IN endpoint must be serviced every 1 ms frame;
# ESP-IDF's default 100 Hz starves the audio task -> host capture fails (arecord EIO).
CONFIG_FREERTOS_HZ=1000
CONFIG_FREERTOS_WATCHPOINT_END_OF_STACK=y
CONFIG_FREERTOS_SUPPORT_STATIC_ALLOCATION=y
```

## examples/west.yml
```yaml
manifest:
  remotes:
    - name: zephyrproject-rtos
      url-base: https://github.com/zephyrproject-rtos
  projects:
    - name: zephyr
      remote: zephyrproject-rtos
      revision: main
      path: zephyr
      import: true
  self:
    path: .
```

## hw/bsp/nrf/boards/pca10056/zephyr/Kconfig.pca10056
```kconfig
# Copyright (c) 2022 Zephyr Project members and individual contributors
# SPDX-License-Identifier: Apache-2.0

config BOARD_PCA10056
	select SOC_NRF52840_QIAA
```

## hw/bsp/nrf/boards/pca10056/zephyr/board.yml
```yaml
board:
  name: pca10056
  full_name: nRF52840 DK
  vendor: nordic
  socs:
  - name: nrf52840
```
